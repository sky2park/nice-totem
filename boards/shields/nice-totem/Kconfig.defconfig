## boards/shields/nice-totem/Kconfig.defconfig
```kconfig
# Copyright (c) 2022 The ZMK Contributors
# SPDX-License-Identifier: MIT

if SHIELD_NICETOTEM_DONGLE

config ZMK_KEYBOARD_NAME
    default "Nice! Totem"
    
config ZMK_SPLIT_ROLE_CENTRAL
    default y

config ZMK_USB
    default y

endif

if SHIELD_NICETOTEM_LEFT || SHIELD_NICETOTEM_RIGHT || SHIELD_NICETOTEM_DONGLE

config ZMK_SPLIT
    default y

config ZMK_BLE
    default y

endif
```

## boards/shields/nice-totem/Kconfig.shield
```kconfig
# Copyright (c) 2022 The ZMK Contributors
# SPDX-License-Identifier: MIT

config SHIELD_NICETOTEM_LEFT
    def_bool $(shields_list_contains,nice-totem_left)

config SHIELD_NICETOTEM_RIGHT
    def_bool $(shields_list_contains,nice-totem_right)

config SHIELD_NICETOTEM_DONGLE
    def_bool $(shields_list_contains,nice-totem_dongle)
```
